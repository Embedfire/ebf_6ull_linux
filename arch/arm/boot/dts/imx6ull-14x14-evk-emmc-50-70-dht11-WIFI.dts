/*
 * Copyright (C) 2016 Freescale Semiconductor, Inc.
 *
 * This program is free software; you can redistribute it and/or modify
 * it under the terms of the GNU General Public License version 2 as
 * published by the Free Software Foundation.
 */
#include "imx6ull-14x14-evk-emmc-50-70-dht11-leds.dts"
#include "imx6ul-evk-btwifi.dtsi"
